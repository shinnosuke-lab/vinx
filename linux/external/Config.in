## linux/external/Config.in
```kconfig
source "$BR2_EXTERNAL_VINX_PATH/package/btmon/Config.in"
source "$BR2_EXTERNAL_VINX_PATH/package/tcc/Config.in"
source "$BR2_EXTERNAL_VINX_PATH/package/termbox2/Config.in"
source "$BR2_EXTERNAL_VINX_PATH/package/vinx-lvgl/Config.in"
source "$BR2_EXTERNAL_VINX_PATH/package/vinx-nasm/Config.in"
source "$BR2_EXTERNAL_VINX_PATH/package/micropython-pylib/Config.in"
source "$BR2_EXTERNAL_VINX_PATH/package/nes/Config.in"
source "$BR2_EXTERNAL_VINX_PATH/package/vol/Config.in"
```

## linux/external/package/btmon/Config.in
```kconfig
config BR2_PACKAGE_BTMON
	bool "btmon"
	help
	  bluez's protocol analyzer, alone: the one tool that turns a
	  btsnoop capture into readable HCI/L2CAP/ATT/SMP traffic
	  (btmon -r trace.btsnoop). Built straight from the bluez
	  tarball without configure, so it does not drag in glib2,
	  dbus or bluetoothd -- a ~400 KB compressed add instead of
	  ~4 MB. There is no Bluetooth controller in this machine;
	  offline analysis is the whole point.

	  https://www.bluez.org
```

## linux/external/package/micropython-pylib/Config.in
```kconfig
config BR2_PACKAGE_MICROPYTHON_PYLIB
	bool "micropython-pylib"
	depends on BR2_PACKAGE_MICROPYTHON
	help
	  The pure-Python parts of micropython-lib's python-stdlib
	  collection, installed to /usr/lib/micropython where the unix
	  port's default sys.path finds them. Fills the gaps CPython
	  habits stumble over: datetime, pathlib, argparse, logging,
	  unittest, shutil, os.path, functools, itertools and more.

	  Named -pylib, not -lib: mainline dropped its micropython-lib
	  package but micropython.mk still carries a dormant
	  BR2_PACKAGE_MICROPYTHON_LIB hook expecting a .built_pylib the
	  dropped package used to make. Reusing that symbol arms the
	  hook and breaks micropython's target install.

	  https://github.com/micropython/micropython-lib
```

## linux/external/package/nes/Config.in
```kconfig
config BR2_PACKAGE_NES
	bool "nes"
	depends on BR2_i386
	select BR2_PACKAGE_LUA
	help
	  The vinx NES console (../../nes): the agnes core plus a
	  homegrown 2A03 APU, painting /dev/fb0, sounding through
	  /dev/dsp, scripted by Lua. Built with the cross gcc at -O2 --
	  comfortably past full NES speed inside v86 -- and installed
	  as /usr/bin/nes, so a ROM dropped on the terminal just runs.

	  https://github.com/kgabis/agnes (the vendored core)
```

## linux/external/package/tcc/Config.in
```kconfig
config BR2_PACKAGE_TCC
	bool "tcc"
	depends on BR2_i386
	help
	  TinyCC: a small, fast C compiler that runs comfortably inside
	  the browser VM. Installs the compiler, its runtime
	  (/usr/lib/tcc) and -- so it can actually compile and link on
	  the target -- the musl and kernel headers plus crt objects
	  from staging.

	  https://bellard.org/tcc/
```

## linux/external/package/termbox2/Config.in
```kconfig
config BR2_PACKAGE_TERMBOX2
	bool "termbox2"
	depends on BR2_i386
	help
	  termbox2 is a single-header terminal UI library: one #include,
	  a dozen calls (tb_init, tb_print, tb_poll_event), no terminfo
	  parsing to get wrong -- the API a language model can use
	  correctly on the first try, and the lightweight alternative to
	  ncurses (whose headers ship here too, for vim's library).
	  Header-only: installing termbox2.h into staging is the whole
	  package; post-build.sh carries it into the target's
	  /usr/include, where `tcc tui.c` (with #define TB_IMPL) finds
	  it. ~+30 KB compressed.

	  https://github.com/termbox/termbox2
```

## linux/external/package/vinx-lvgl/Config.in
```kconfig
config BR2_PACKAGE_VINX_LVGL
	bool "vinx-lvgl"
	depends on BR2_i386
	help
	  LVGL v9 as a shared library for the machine's own C compilers:
	  `tcc gui.c -llvgl` paints widgets on /dev/fb0 (the Bochs DRM
	  framebuffer the screen panel shows) and reads the pointer and
	  keyboard from evdev. Headers land in /usr/include/lvgl with the
	  config at /usr/include/lv_conf.h, the layout both gcc and tcc
	  resolve. Mainline Buildroot has no lvgl package; the vinx-
	  prefix marks it as this tree's own. ~+1.3 MB compressed.

	  Chinese text works out of the box: the rootfs overlay ships a
	  GB2312 bitmap font at /usr/share/fonts/cjk16.bin and
	  lv_binfont_create loads it at runtime -- see lvdemo(1) and the
	  linux-vm skill.

	  https://lvgl.io
```

## linux/external/package/vinx-nasm/Config.in
```kconfig
config BR2_PACKAGE_VINX_NASM
	bool "vinx-nasm"
	depends on BR2_i386
	help
	  NASM running *on* the i686 target: Intel-syntax assembly as a
	  first-class language on a machine that really is an i686.
	  `nasm -f elf32 x.asm && tcc x.o -o x` builds and links; ndisasm
	  rides along as the disassembler. Mainline Buildroot only ships
	  nasm as a host tool (that is why this package carries the vinx-
	  prefix -- the mainline name would collide), so this one is the
	  same tarball cross-compiled for the target. ~+0.7 MB compressed.

	  https://www.nasm.us
```

## linux/external/package/vinx-rpc/Config.in
```kconfig
config BR2_PACKAGE_VINX_RPC
	bool "vinx-rpc"
	help
	  The machine's control plane (docs/system-v2.zh-CN.md §6): rpcd
	  holds /dev/ttyS3 exclusively and speaks VX1/VXA frames carrying
	  a JSON-RPC subset to the hosting page; everything else in the
	  guest reaches it over /run/vinx/rpc.sock. rund serves proc.run;
	  rpc(1) is the CLI that js(1)/fetch(1) ride; libvinxrpc.a with
	  vinx_rpc.h is the tcc-linkable client (§6.10).
```

## linux/external/package/vol/Config.in
```kconfig
config BR2_PACKAGE_VOL
	bool "vol"
	help
	  The machine's volume knob. ALSA brings the SB16 up with every
	  control at zero -- on real hardware alsactl restores levels at
	  boot, but this image ships no alsa-utils, so the card stays
	  muted and /dev/dsp plays silence. vol(1) sets master and PCM
	  through the OSS mixer (/dev/mixer, CONFIG_SND_MIXER_OSS) and
	  its S25vol init script turns the knob to 100 at boot.
```
